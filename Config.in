## Config.in
```kconfig
config ELOGD_ASSERT
	bool "Assertion"
	default n
	help
	  Build eLogd with internal assertions.

config ELOGD_DEBUG
	bool "Debugging support"
	default n
	help
	  Build eLogd with debugging support.

config ELOGD_USER
	string "runtime user name"
	default "elogd"
	help
	  System user name which eLogd daemon will switch to at running time.

config ELOGD_RUNSTATEDIR_ENVVAR
	string
	option env="RUNSTATEDIR"

config ELOGD_RUNSTATEDIR
	string
	default ELOGD_RUNSTATEDIR_ENVVAR

config ELOGD_RUNSTATEDIR_GROUP
	string "Rundir directory group"
	default "logpost"
	help
	  Group assigned to directory where volatile internal state data are
	  stored. This group will also be assigned to syslog source socket at
	  creation time.
	  Note that the system user selected by CONFIG_ELOGD_USER MUST be a
	  member of this group.

config ELOGD_STDLOG_SEVERITY
	int "STDIO logger severity"
	range 0 7
	default 3
	help
	  Internal eLogd daemon messages with severity greater than this won't
	  be sent to standard I/O logger.
	  See syslog(3) levels for more informations about available severities.

config ELOGD_FETCH_MIN
	int
	default 1

config ELOGD_FETCH_MAX
	int
	default 1024

menu "Internal log source"

config ELOGD_INTLOG_SEVERITY
	int "Internal logger severity"
	range 0 7
	default 4
	help
	  Internal eLogd daemon messages with severity greater than this won't
	  be sent to internal logging queue.
	  See syslog(3) levels for more informations about available severities.

config ELOGD_INTLOG_FETCH
	int "Number of internal eLogd message fetches"
	range ELOGD_FETCH_MIN ELOGD_FETCH_MAX
	default 32
	help
	  Number of internal messages that eLogd daemon will fetch in a single
	  polling iteration.

endmenu # menu "Internal logging source"



menuconfig ELOGD_KERN
	bool "Kernel log source"
	default y
	help
	  Enable support for fetching messages from kernel log ring-buffer
	  source.

if ELOGD_KERN

config ELOGD_KERN_GROUP
	string "Kernel ring-buffer device group"
	default "klog"
	help
	  At opening time, check that the kernel ring-buffer character device
	  file is assigned this group membership.
	  Note that the system user selected by CONFIG_ELOGD_USER MUST be a
	  member of this group.

config ELOGD_KERN_FETCH
	int "Number of kernel message fetches"
	range ELOGD_FETCH_MIN ELOGD_FETCH_MAX
	default 32
	help
	  Number of kernel messages that eLogd daemon will fetch in a single
	  polling iteration.

endif # menuconfig ELOGD_KERN

menuconfig ELOGD_MQUEUE
	bool "Message queue log source"
	default y
	help
	  Enable support for fetching messages from POSIX named message queue.
	  See mq_overview(7) for informations.

if ELOGD_MQUEUE

config ELOGD_MQUEUE_NAME
	string "Message queue name"
	default "/init"
	help
	  Name of POSIX message queue exposed service.
	  See mq_overview(7) for informations about message queue identifiers.

config ELOGD_MQUEUE_FETCH
	int "Number of message queue fetches"
	range ELOGD_FETCH_MIN ELOGD_FETCH_MAX
	default 32
	help
	  Number of message queue messages that eLogd daemon will fetch in a
	  single polling iteration.

choice
	prompt "Message queue reordering strategy"
	default ELOGD_MQUEUE_REORDER_MERGE
	help
	  Strategy used to reorder messages retrieved from message queue in the
	  time space.

config ELOGD_MQUEUE_REORDER_MERGE
	bool "Merge sort"
	help
	  Use merge sort algorithm to reorder messages retrieved from message
	  queue in the time space.

config ELOGD_MQUEUE_REORDER_INSERT
	bool "Insertion sort"
	help
	  Use online insertion sort algorithm to reorder messages retrieved from
	  message queue in the time space.

endchoice

endif # menuconfig ELOGD_MQUEUE

menu "Syslog socket source"

config ELOGD_SOCK_FETCH
	int "Number of syslog message fetches"
	range ELOGD_FETCH_MIN ELOGD_FETCH_MAX
	default 32
	help
	  Number of syslog socket messages that eLogd daemon will fetch in a
	  single polling iteration.

endmenu

config ELOGD_DELAY_MIN
	int
	default 1

config ELOGD_DELAY_MAX
	int
	default 60

config ELOGD_DELAY
	int "Message storage delay"
	range ELOGD_DELAY_MIN ELOGD_DELAY_MAX
	default 1
	help
	  Number of seconds to wait before saving a message into the message
	  store.

menu "Logging message store"

config ELOGD_STORE_DPATH
	string "Output directory path"
	default "/run/elog"
	help
	  Pathname to directory where logging output files will be stored.

config ELOGD_STORE_FBASE
	string "Output file basename"
	default "messages"
	help
	  Logging output file path basename.

config ELOGD_STORE_GROUP
	string "Output file group"
	default "logstore"
	help
	  At creation time, logging output files will be assigned to this group.
	  Note that the system user selected by CONFIG_ELOGD_USER MUST be a
	  member of this group.

config ELOGD_STORE_SIZE_MIN
	int
	default 4096

config ELOGD_STORE_SIZE_MAX
	int
	default 2147483647

config ELOGD_STORE_SIZE
	int "Maximum output file size"
	range ELOGD_STORE_SIZE_MIN ELOGD_STORE_SIZE_MAX
	default 131072
	help
	  Maximum size in bytes of a single occurence of a logging output file.

config ELOGD_STORE_ROT_MIN
	int
	default 1

config ELOGD_STORE_ROT_MAX
	int
	default 1000

config ELOGD_STORE_ROT
	int "Number of output file rotations"
	range ELOGD_STORE_ROT_MIN ELOGD_STORE_ROT_MAX
	default 2
	help
	  Maximum number of archived logging output file.

endmenu

## ex: filetype=kconfig
```
